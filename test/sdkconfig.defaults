## test/sdkconfig.defaults
```kconfig
# Test project SDK configuration defaults
CONFIG_IDF_TARGET="esp32c3"
CONFIG_ESPTOOLPY_FLASHMODE_DIO=y
CONFIG_ESPTOOLPY_FLASHFREQ_80M=y
CONFIG_ESPTOOLPY_FLASHSIZE_2MB=y

# Enable Unity testing
CONFIG_UNITY_ENABLE=y
CONFIG_UNITY_ENABLE_FLOAT=y
CONFIG_UNITY_ENABLE_DOUBLE=y
CONFIG_UNITY_ENABLE_64BIT=y
CONFIG_UNITY_ENABLE_COLOR=y
CONFIG_UNITY_ENABLE_IDF_TEST_RUNNER=y
CONFIG_UNITY_ENABLE_FIXTURE=y
CONFIG_UNITY_ENABLE_BACKTRACE_ON_FAIL=y

# Enable components needed for testing
CONFIG_ESP_WIFI_ENABLED=y
CONFIG_ESP_EVENT_ENABLED=y
CONFIG_NVS_ENABLED=y
CONFIG_SPIFFS_ENABLED=y
CONFIG_DRIVER_ENABLED=y

# Disable some features for testing
CONFIG_ESP_CONSOLE_UART_DEFAULT=y
CONFIG_ESP_CONSOLE_UART_NUM=0
CONFIG_ESP_CONSOLE_UART_BAUDRATE=115200 
```
